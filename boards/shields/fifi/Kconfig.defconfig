## boards/shields/fifi/Kconfig.defconfig
```kconfig
if  SHIELD_FIFI_DONGLE_PRO_MICRO

config ZMK_KEYBOARD_NAME
    default "Kurofi"

config ZMK_SPLIT_ROLE_CENTRAL
    default y

endif

if SHIELD_FIFI_RIGHT || SHIELD_FIFI_LEFT_PERIPHERAL || SHIELD_FIFI_DONGLE_PRO_MICRO

config ZMK_SPLIT
    default y

endif

if SHIELD_FIFI_DONGLE_PRO_MICRO

if ZMK_DISPLAY

config I2C
    default y

config SSD1306
    default y

choice ZMK_DISPLAY_WORK_QUEUE
    default ZMK_DISPLAY_WORK_QUEUE_DEDICATED
endchoice

endif # ZMK_DISPLAY

if LVGL

config LV_Z_VDB_SIZE
    default 64

config LV_DPI_DEF
    default 148

config LV_Z_BITS_PER_PIXEL
    default 1

choice LV_COLOR_DEPTH
    default LV_COLOR_DEPTH_1
endchoice

endif # LVGL

endif
```

## boards/shields/fifi/Kconfig.shield
```kconfig
# Copyright (c) 2020 Pete Johanson
# SPDX-License-Identifier: MIT

config SHIELD_FIFI_RIGHT
    def_bool $(shields_list_contains,fifi_right)

config SHIELD_FIFI_LEFT_PERIPHERAL
    def_bool $(shields_list_contains,fifi_left_peripheral)

config SHIELD_FIFI_DONGLE_PRO_MICRO
    def_bool $(shields_list_contains,fifi_dongle_pro_micro)
```

## config/west.yml
```yaml
manifest:
  remotes:
    - name: zmkfirmware
      url-base: https://github.com/zmkfirmware
    # dongle_display
    - name: englmaxi
      url-base: https://github.com/englmaxi
  projects:
    - name: zmk
      remote: zmkfirmware
      revision: main
      import: app/west.yml
    # dongle_display
    - name: zmk-dongle-display
      remote: englmaxi
      revision: main
  self:
    path: config
```
